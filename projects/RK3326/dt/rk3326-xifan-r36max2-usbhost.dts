// SPDX-License-Identifier: (GPL-2.0+ OR MIT)
/* r36max2 + the second USB2 host port turned on (OTG keyboard / mouse test) */
#include "rk3326-xifan-r36max2.dts"

&u2phy {
	status = "okay";

	u2phy_host: host-port {
		status = "okay";
	};
};

&usb_host0_ehci {
	status = "okay";
};

&usb_host0_ohci {
	status = "okay";
};
